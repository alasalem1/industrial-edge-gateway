## meta-sentinel-edge/conf/distro/sentinel-edge.conf
```bitbake
# SentinelEdge Linux Distribution
# Based on OpenEmbedded-Core (OE-Core)

DISTRO = "sentinel-edge"
DISTRO_NAME = "SentinelEdge Linux"
DISTRO_VERSION = "1.0"

# System initialization
INIT_MANAGER = "systemd"

# Development configuration
EXTRA_IMAGE_FEATURES = "debug-tweaks"
```

## meta-sentinel-edge/conf/layer.conf
```bitbake
# SentinelEdge Platform Layer

BBPATH .= ":${LAYERDIR}"

BBFILES += "${LAYERDIR}/recipes-*/*/*.bb"
BBFILES += "${LAYERDIR}/recipes-*/*/*.bbappend"

BBFILE_COLLECTIONS += "sentinel_edge"
BBFILE_PATTERN_sentinel_edge = "^${LAYERDIR}/"
BBFILE_PRIORITY_sentinel_edge = "6"

LAYERSERIES_COMPAT_sentinel_edge = "scarthgap"

LAYERDEPENDS_sentinel_edge = "core"
```
